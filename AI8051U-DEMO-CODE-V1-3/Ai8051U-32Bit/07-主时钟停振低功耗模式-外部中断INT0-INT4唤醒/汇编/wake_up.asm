;/*---------------------------------------------------------------------*/
;/* --- Web: www.STCAI.com ---------------------------------------------*/
;/*---------------------------------------------------------------------*/

;*************  功能说明    **************

; 本例程基于AI8051U为主控芯片的实验箱进行编写测试。

; 使用Keil C251编译器，Memory Model推荐设置XSmall模式，默认定义变量在edata，单时钟存取访问速度快。

; edata建议保留1K给堆栈使用，空间不够时可将大数组、不常用变量加xdata关键字定义到xdata空间。

; 显示效果为: 上电后跑马灯显示2秒, 然后进入睡眠模式.

; 按板上的INT0、INT1按键唤醒, 继续显示2秒后再进入睡眠模式.

; 如果按键一直按着(INT0/INT1为低电平), 则MCU不睡眠, 直到INT0/INT1为高电平为止.

; INT2, INT3, INT4 实验板上没有引出测试按键，供需要时参考使用.

; 下载时, 选择时钟 24MHZ (用户可自行修改频率).

;******************************************

$include (../../comm/AI8051U.INC)

;****************************** 用户定义宏 ***********************************/

Fosc_KHZ    EQU 24000   ;24000KHZ

STACK_POIRTER   EQU     0D0H    ; 堆栈开始地址

;*******************************************************************
;*******************************************************************

;*************  本地变量声明    **************/

msecond         DATA    39H     ;

;*******************************************************************
;*******************************************************************
        ORG     0000H               ;程序复位入口，编译器自动定义到 0FF0000H 地址
        LJMP    F_Main

        ORG     0003H               ;0 INT0 interrupt
        LJMP    F_INT0_Interrupt      

        ORG     0013H               ;2  INT1 interrupt
        LJMP    F_INT1_Interrupt      


;*******************************************************************
;*******************************************************************


;******************** 主程序 **************************/
        ORG     0100H       ;编译器自动定义到 0FF0100H 地址
F_Main:
    MOV     WTST, #00H     ;设置程序指令延时参数，赋值为0可将CPU执行指令的速度设置为最快
    MOV     CKCON,#00H     ;提高访问XRAM速度
    ORL     P_SW2,#080H    ;使能访问XFR

    MOV     P0M1, #00H     ;设置为准双向口
    MOV     P0M0, #00H
    MOV     P1M1, #00H     ;设置为准双向口
    MOV     P1M0, #00H
    MOV     P2M1, #00H     ;设置为准双向口
    MOV     P2M0, #00H
    MOV     P3M1, #00H     ;设置为准双向口
    MOV     P3M0, #00H
    MOV     P4M1, #00H     ;设置为准双向口
    MOV     P4M0, #00H
    MOV     P5M1, #00H     ;设置为准双向口
    MOV     P5M0, #00H
    MOV     P6M1, #00H     ;设置为准双向口
    MOV     P6M0, #00H
    MOV     P7M1, #00H     ;设置为准双向口
    MOV     P7M0, #00H

    MOV     SP, #STACK_POIRTER
    MOV     PSW, #0
    USING   0       ;选择第0组R0~R7

;================= 用户初始化程序 ====================================

    CLR     P4.0        ;LED Power On
    MOV     R0, #0XFE
    SETB    EA      ;允许总中断

;=================== 主循环 ==================================
L_MainLoop:
    MOV     A, #100         ;延时100ms
    LCALL   F_delay_ms  

    ;跑马灯指示工作状态
    MOV     P0,R0
    MOV     A,R0
    RL      A
    MOV     R0,A

    ;2秒后MCU进入休眠状态
    MOV     WR6, msecond
    INC     WR6, #1         ;msecond + 1
    MOV     msecond, WR6
    CMP     WR6, #20
    JC      L_MainLoop      ;2秒后睡眠
    MOV     WR6, #0
    MOV     msecond, WR6    ;msecond = 0

    JNB     INT0, L_MainLoop;高电平时才进入睡眠
    JNB     INT1, L_MainLoop;高电平时才进入睡眠
    MOV     A, #10      ;延时10ms
    LCALL   F_delay_ms  
    JNB     INT0, L_MainLoop;高电平时才进入睡眠
    JNB     INT1, L_MainLoop;高电平时才进入睡眠
    
    MOV     P0,#0xff    ;关闭显示，省电

    CLR     IE1     ;外中断1标志位
    CLR     IE0     ;外中断0标志位
    SETB    EX1     ;INT1 Enable
    SETB    EX0     ;INT0 Enable

    SETB    IT0     ;INT0 下降沿中断        
;   CLR     IT0     ;INT0 上升,下降沿中断   
    SETB    IT1     ;INT1 下降沿中断        
;   CLR     IT1     ;INT1 上升,下降沿中断

    ;INT2, INT3, INT4 实验板上没有引出测试按键，供需要时参考使用
;    SETB     EX2  ;使能 INT2 下降沿中断
;    SETB     EX3  ;使能 INT3 下降沿中断
;    SETB     EX4  ;使能 INT4 下降沿中断

    ORL     PCON, #0x02     ;Sleep
    NOP
    NOP
    NOP
    NOP
    NOP
    NOP
    NOP

    LJMP    L_MainLoop

;========================================================================
; 函数: F_delay_ms
; 描述: 延时子程序。
; 参数: ACC: 延时ms数.
; 返回: none.
; 版本: VER1.0
; 日期: 2021-3-16
; 备注: 除了ACCC和PSW外, 所用到的通用寄存器都入栈
;========================================================================
F_delay_ms:
    PUSH    02H     ;入栈R2
    PUSH    03H     ;入栈R3
    PUSH    04H     ;入栈R4

    MOV     R4,A
L_delay_ms_1:
    MOV     WR2, #(Fosc_KHZ / 4)
L_delay_ms_2:
    DEC     WR2, #1         ;1T
    JNE     L_delay_ms_2    ;3T
    DJNZ    R4, L_delay_ms_1

    POP     04H     ;出栈R4
    POP     03H     ;出栈R3
    POP     02H     ;出栈R2
    RET

;========================================================================
; 函数: F_INT0_Interrupt
; 描述: INT0中断函数.
; 参数: none.
; 返回: none.
; 版本: VER1.0
; 日期: 2023-4-1
; 备注: 所用到的通用寄存器都入栈保护, 退出时恢复原来数据不改变.
;========================================================================
F_INT0_Interrupt:
    CLR     EX0     ;INT0 Disable
    RETI
    
;========================================================================
; 函数: F_INT1_Interrupt
; 描述: INT1中断函数.
; 参数: none.
; 返回: none.
; 版本: VER1.0
; 日期: 2023-4-1
; 备注: 所用到的通用寄存器都入栈保护, 退出时恢复原来数据不改变.
;========================================================================
F_INT1_Interrupt:
    CLR     EX1     ;INT1 Disable
    RETI


    END

