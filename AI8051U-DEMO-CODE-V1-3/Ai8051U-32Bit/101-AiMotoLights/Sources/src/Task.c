/*---------------------------------------------------------------------*/
/* --- Web: www.STCAI.com ---------------------------------------------*/
/*---------------------------------------------------------------------*/

#include "Task.h"
#include "app.h"

//========================================================================
// 集成独立监控插件（可选，需要时才包含）
//========================================================================
#include "TaskMonitor/TaskMonitor.h"   // 任务性能监控插件
#include "CPUMonitor/CPUMonitor.h"     // CPU占用率监控插件

//========================================================================
//                               本地变量声明
//========================================================================

static TASK_COMPONENTS Task_Comps[]=
{
//状态  计数  周期  函数
    //========================================================================
    // 摩托车智能联动灯组系统任务
    //========================================================================
    {0, 10,  10,  Sample_VehicleSignal},        /* task 1: 原车信号检测, 10ms */
    {0, 10,  10,  Sample_PWM_Output},           /* task 2: PWM输出更新, 10ms */
    {0, 20,  20,  Sample_LightScheduler},       /* task 3: 灯光调度器, 20ms */
    {0, 50,  50,  Sample_MotoLights_App},       /* task 4: 主应用层, 50ms */
    {0, 100, 100, Sample_Sensors},              /* task 5: 传感器采样, 100ms */
    {0, 100, 100, Sample_StatusIndicator},      /* task 6: 状态指示, 100ms */
    
    //========================================================================
    // 外部中断按键任务
    //========================================================================
#if ENABLE_INT_KEY
    {0, 10,  10,  Sample_intKey},               /* task 7: 外部中断按键, 10ms */
#endif
    
    //========================================================================
    // 监控插件任务（可选）
    //========================================================================
    {0, 1000,1000,CPUMonitor_Calculate},        /* CPU监控：每秒计算占用率 */
    {0, 5000,5000,TaskMonitor_PrintReport},     /* 任务监控：每5秒打印报告 */
    {0, 5000,5000,CPUMonitor_PrintReport},      /* CPU监控：每5秒打印报告 */

    //========================================================================
    // USB HID 调试任务
    //========================================================================
    {0, 1,   1,   Sample_USB_Debug},            /* USB调试：每1ms执行一次 */

    /* Add new task here */
};

u8 Tasks_Max = sizeof(Task_Comps)/sizeof(Task_Comps[0]);

//========================================================================
// 函数: Task_Handler_Callback
// 描述: 任务标记回调函数.
// 参数: None.
// 返回: None.
// 版本: V1.0, 2012-10-22
//========================================================================
void Task_Marks_Handler_Callback(void)
{
    u8 i;
    for(i=0; i<Tasks_Max; i++)
    {
        if(Task_Comps[i].TIMCount)      /* If the time is not 0 */
        {
            Task_Comps[i].TIMCount--;   /* Time counter decrement */
            if(Task_Comps[i].TIMCount == 0) /* If time arrives */
            {
                /*Resume the timer value and try again */
                Task_Comps[i].TIMCount = Task_Comps[i].TRITime;  
                Task_Comps[i].Run = 1;      /* The task can be run */
            }
        }
    }
}

//========================================================================
// 函数: Task_Pro_Handler_Callback
// 描述: 任务处理回调函数.
// 参数: None.
// 返回: None.
// 版本: V1.0, 2012-10-22
//========================================================================
void Task_Pro_Handler_Callback(void)
{
    u8 i;
    for(i=0; i<Tasks_Max; i++)
    {
        if(Task_Comps[i].Run) /* If task can be run */
        {
            //================================================================
            // 优化4：TaskMonitor插件钩子 - 任务开始
            //================================================================
            TASK_MONITOR_START(i);
            
            Task_Comps[i].Run = 0;      /* Flag clear 0 */
            Task_Comps[i].TaskHook();   /* Run task */
            
            //================================================================
            // 优化4：TaskMonitor插件钩子 - 任务结束
            //================================================================
            TASK_MONITOR_END(i);
        }
    }
}
