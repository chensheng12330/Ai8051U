;/*---------------------------------------------------------------------*/
;/* --- Web: www.STCAI.com ---------------------------------------------*/
;/*---------------------------------------------------------------------*/

;*************  功能说明    **************

;本例程基于AI8051U为主控芯片的实验箱进行编写测试。

;使用Keil C251编译器，Memory Model推荐设置XSmall模式，默认定义变量在edata，单时钟存取访问速度快。

;edata建议保留1K给堆栈使用，空间不够时可将大数组、不常用变量加xdata关键字定义到xdata空间。

;用串口打印INT中断计数结果（INT0与数码管控制接口复用，不能用数码管显示）。

;串口(P30,P31)默认设置：115200,N,8,1，使用HEX模式打印.

;由于按键是机械按键, 按下有抖动, 而本例程没有去抖动处理, 所以按一次有多个计数也是正常的.

;INT2, INT3, INT4 实验板上没有引出测试按键，供需要时参考使用.

;下载时, 选择时钟 24MHZ (用户可自行修改频率).

;******************************************

$include (../../comm/AI8051U.INC)

;****************************** 用户定义宏 ***********************************/

Fosc_KHZ    EQU 24000   ;24000KHZ

STACK_POIRTER   EQU     0D0H    ; 堆栈开始地址

;*******************************************************************

;*************  本地变量声明    **************/

Flag0           DATA    20H
B_INT0_Flag     BIT     Flag0.0 ; INT0触发标志
B_INT1_Flag     BIT     Flag0.1 ; INT0触发标志
B_INT2_Flag     BIT     Flag0.2 ; INT0触发标志
B_INT3_Flag     BIT     Flag0.3 ; INT0触发标志
B_INT4_Flag     BIT     Flag0.4 ; INT0触发标志

INT0_cnt        DATA    39H     ; 测试用的计数变量
INT1_cnt        DATA    3AH     ;
INT2_cnt        DATA    3BH     ;
INT3_cnt        DATA    3CH     ;
INT4_cnt        DATA    3DH     ;

;========================================================================
; 描述: 串口1发送1字节数据。
; 参数: P_DATA: 发送的数据.
;========================================================================
PRINT MACRO P_DATA
    MOV     SBUF, P_DATA    ;发送一个字节
    JNB     TI, $           ;等待发送完成
    CLR     TI
ENDM

;*******************************************************************
;*******************************************************************
        ORG     0000H               ;程序复位入口，编译器自动定义到 0FF0000H 地址
        LJMP    F_Main


        ORG     0003H               ;0  INT0 interrupt
        LJMP    F_INT0_Interrupt      

        ORG     0013H               ;2  INT1 interrupt
        LJMP    F_INT1_Interrupt      

        ORG     0053H               ;10 INT2 interrupt
        LJMP    F_INT2_Interrupt      

        ORG     005BH               ;11 INT3 interrupt
        LJMP    F_INT3_Interrupt      

        ORG     0083H               ;16 INT4 interrupt
        LJMP    F_INT4_Interrupt      


;*******************************************************************
;*******************************************************************


;******************** 主程序 **************************/
        ORG     0100H       ;编译器自动定义到 0FF0100H 地址
F_Main:
    MOV     WTST, #00H     ;设置程序指令延时参数，赋值为0可将CPU执行指令的速度设置为最快
    MOV     CKCON,#00H     ;提高访问XRAM速度
    ORL     P_SW2,#080H    ;使能访问XFR

    MOV     P0M1, #00H     ;设置为准双向口
    MOV     P0M0, #00H
    MOV     P1M1, #00H     ;设置为准双向口
    MOV     P1M0, #00H
    MOV     P2M1, #00H     ;设置为准双向口
    MOV     P2M0, #00H
    MOV     P3M1, #00H     ;设置为准双向口
    MOV     P3M0, #00H
    MOV     P4M1, #00H     ;设置为准双向口
    MOV     P4M0, #00H
    MOV     P5M1, #00H     ;设置为准双向口
    MOV     P5M0, #00H
    MOV     P6M1, #00H     ;设置为准双向口
    MOV     P6M0, #00H
    MOV     P7M1, #00H     ;设置为准双向口
    MOV     P7M0, #00H

    MOV     SP, #STACK_POIRTER
    MOV     PSW, #0
    USING   0       ;选择第0组R0~R7

;================= 用户初始化程序 ====================================

    CLR     IE1     ;外中断1标志位
    CLR     IE0     ;外中断0标志位
    SETB    EX1     ;INT1 Enable
    SETB    EX0     ;INT0 Enable

    SETB    IT0     ;INT0 下降沿中断        
;   CLR     IT0     ;INT0 上升,下降沿中断   
    SETB    IT1     ;INT1 下降沿中断        
;   CLR     IT1     ;INT1 上升,下降沿中断

    ;INT2, INT3, INT4 实验板上没有引出测试按键，供需要时参考使用
;    SETB    EX2
;    SETB    EX3
;    SETB    EX4

    LCALL   UART1_INIT
    SETB    EA      ;允许总中断
    
    MOV     INT0_cnt, #0
    MOV     INT1_cnt, #0

;=================== 主循环 ==================================
L_MainLoop:
    JNB     B_INT0_Flag,  L_INT1_Test
    CLR     B_INT0_Flag

    PRINT   #030H           ;"0"
    PRINT   INT0_cnt

L_INT1_Test:
    JNB     B_INT1_Flag,  L_MainLoop
    CLR     B_INT1_Flag

    PRINT   #031H           ;"1"
    PRINT   INT1_cnt

    LJMP    L_MainLoop

;========================================================================
; 函数: F_INT0_Interrupt
; 描述: INT0中断函数.
; 参数: none.
; 返回: none.
; 版本: VER1.0
; 日期: 2013-4-1
; 备注: 所用到的通用寄存器都入栈保护, 退出时恢复原来数据不改变.
;========================================================================
F_INT0_Interrupt:
    INC     INT0_cnt    ; 中断+1
    SETB    B_INT0_Flag
    RETI
    
;========================================================================
; 函数: F_INT1_Interrupt
; 描述: INT1中断函数.
; 参数: none.
; 返回: none.
; 版本: VER1.0
; 日期: 2013-4-1
; 备注: 所用到的通用寄存器都入栈保护, 退出时恢复原来数据不改变.
;========================================================================
F_INT1_Interrupt:
    INC     INT1_cnt    ; 中断+1
    SETB    B_INT1_Flag
    RETI

;========================================================================
; 函数: F_INT2_Interrupt
; 描述: INT2中断函数.
; 参数: none.
; 返回: none.
; 版本: VER1.0
; 日期: 2020-11-4
; 备注: 所用到的通用寄存器都入栈保护, 退出时恢复原来数据不改变.
;========================================================================
F_INT2_Interrupt:
    INC     INT2_cnt    ; 中断+1
    SETB    B_INT2_Flag
    RETI

;========================================================================
; 函数: F_INT3_Interrupt
; 描述: INT3中断函数.
; 参数: none.
; 返回: none.
; 版本: VER1.0
; 日期: 2020-11-4
; 备注: 所用到的通用寄存器都入栈保护, 退出时恢复原来数据不改变.
;========================================================================
F_INT3_Interrupt:
    INC     INT3_cnt    ; 中断+1
    SETB    B_INT3_Flag
    RETI

;========================================================================
; 函数: F_INT4_Interrupt
; 描述: INT4中断函数.
; 参数: none.
; 返回: none.
; 版本: VER1.0
; 日期: 2020-11-4
; 备注: 所用到的通用寄存器都入栈保护, 退出时恢复原来数据不改变.
;========================================================================
F_INT4_Interrupt:
    INC     INT4_cnt    ; 中断+1
    SETB    B_INT4_Flag
    RETI

;========================================================================
; 函数: UART1_INIT
; 描述: UART1初始化程序.
; 参数: None
; 返回: none.
; 版本: V1.0, 2024-07-22
;========================================================================
UART1_INIT:                 ;115200bps@24.000MHz
    MOV     SCON,#50H       ;8位数据,可变波特率
    ORL     AUXR,#40H       ;定时器时钟1T模式
    ANL     AUXR,#0FEH      ;串口1选择定时器1为波特率发生器
    ANL     TMOD,#0FH       ;设置定时器模式
    MOV     TL1,#0CCH       ;设置定时初始值
    MOV     TH1,#0FFH       ;设置定时初始值
    CLR     ET1             ;禁止定时器中断
    SETB    TR1             ;定时器1开始计时

    ANL     P_SW1, #0x3f
    ORL     P_SW1, #0x00    ;UART1 switch to, 0x00: P3.0 P3.1, 0x40: P3.6 P3.7, 0x80: P1.6 P1.7, 0xC0: P4.3 P4.4
    RET

;========================================================================
    END
