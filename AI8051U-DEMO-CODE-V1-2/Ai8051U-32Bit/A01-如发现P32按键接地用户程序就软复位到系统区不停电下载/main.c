/*---------------------------------------------------------------------*/
/* --- Web: www.STCAI.com ---------------------------------------------*/
/*---------------------------------------------------------------------*/

/*************  功能说明    **************

本例程基于AI8051U为主控芯片的实验箱进行编写测试.

使用Keil C251编译器，Memory Model推荐设置XSmall模式，默认定义变量在edata，单时钟存取访问速度快。

edata建议保留1K给堆栈使用，空间不够时可将大数组、不常用变量加xdata关键字定义到xdata空间。

程序使用P0口来演示跑马灯，输出低驱动。

使用USB线连接电脑跟MCU。
程序通过判断P32口按键长按后执行MCU软复位指令，进入USB下载模式，
然后在AIapp-ISP软件点击“下载/编程”按钮进行下载。
（软件复位进入ISP会重新置位RSTFLAG，系统ISP程序不用判断P3.2电平，如果P3.0/P3.1同时为低电平的话就会进入USB下载模式）

下载时, 选择时钟 24MHz (用户可自行修改频率).

******************************************/

#include "../comm/AI8051U.h"

//==========================================================================

typedef unsigned char   u8;
typedef unsigned int    u16;
typedef unsigned long   u32;

/*************  本地常量声明    **************/

#define MAIN_Fosc       24000000L   //定义主时钟
#define Timer0_Reload   (65536UL -(MAIN_Fosc / 1000))       //Timer 0 中断频率, 1000次/秒

/*************  IO口定义    **************/


/*************  本地变量声明    **************/

//P3.2口按键复位所需变量
bit Key_Flag;
u16 Key_cnt;

/*************  本地函数声明    **************/

void Timer0_Init(void);
void delay_ms(u8 ms);

/****************  外部函数声明和外部变量声明 *****************/


/******************** 主函数 **************************/
void main(void)
{
    WTST = 0;   //设置程序指令延时参数，赋值为0可将CPU执行指令的速度设置为最快
    EAXFR = 1;  //扩展寄存器(XFR)访问使能
    CKCON = 0;  //提高访问XRAM速度

    RSTFLAG |= 0x04;   //软复位标志写1清零，设置硬件复位后需要检测P3.2的状态选择运行区域，硬件复位后进入系统ISP检测到P3.2为低电平，才会进入USB下载模式

    P0M1 = 0x00;   P0M0 = 0xff;   //设置为推挽输出
    P1M1 = 0x00;   P1M0 = 0x00;   //设置为准双向口
    P2M1 = 0x00;   P2M0 = 0x00;   //设置为准双向口
    P3M1 = 0x00;   P3M0 = 0x00;   //设置为准双向口
    P4M1 = 0x00;   P4M0 = 0x00;   //设置为准双向口
    P5M1 = 0x00;   P5M0 = 0x00;   //设置为准双向口
    P6M1 = 0x00;   P6M0 = 0x00;   //设置为准双向口
    P7M1 = 0x00;   P7M0 = 0x00;   //设置为准双向口

    Timer0_Init();
    EA = 1;         //打开总中断
    P40 = 0;        //LED Power On

    while(1)
    {
        P00 = 0;        //LED On
        delay_ms(250);
        P00 = 1;        //LED Off

        P01 = 0;        //LED On
        delay_ms(250);
        P01 = 1;        //LED Off

        P02 = 0;        //LED On
        delay_ms(250);
        P02 = 1;        //LED Off

        P03 = 0;        //LED On
        delay_ms(250);
        P03 = 1;        //LED Off

        P04 = 0;        //LED On
        delay_ms(250);
        P04 = 1;        //LED Off

        P05 = 0;        //LED On
        delay_ms(250);
        P05 = 1;        //LED Off

        P06 = 0;        //LED On
        delay_ms(250);
        P06 = 1;        //LED Off

        P07 = 0;        //LED On
        delay_ms(250);
        P07 = 1;        //LED Off
    }
}

//========================================================================
// 函数: void Timer0_Init(void)
// 描述: 定时器0初始化函数。
// 参数: none.
// 返回: none.
// 版本: VER1.0
// 日期: 2022-6-2
// 备注: 
//========================================================================
void Timer0_Init(void)
{
    // Timer0初始化
    AUXR = 0x80;    //Timer0 set as 1T, 16 bits timer auto-reload, 
    TH0 = (u8)(Timer0_Reload / 256);
    TL0 = (u8)(Timer0_Reload % 256);
    ET0 = 1;    //Timer0 interrupt enable
    TR0 = 1;    //Tiner0 run
}

//========================================================================
// 函数: void delay_ms(u8 ms)
// 描述: 延时函数。
// 参数: ms,要延时的ms数, 这里只支持1~255ms. 自动适应主时钟.
// 返回: none.
// 版本: VER1.0
// 日期: 2022-6-3
// 备注: 
//========================================================================
void delay_ms(u8 ms)
{
    u16 i;
    do{
        i = MAIN_Fosc / 6000;
        while(--i);   //6T per loop
    }while(--ms);
}

//========================================================================
// 函数: void KeyResetScan(void)
// 描述: P3.2口按键长按1秒触发软件复位，进入USB下载模式。
// 参数: none.
// 返回: none.
// 版本: VER1.0
// 日期: 2022-6-11
// 备注: 
//========================================================================
void KeyResetScan(void)
{
    if(!P32)
    {
        if(!Key_Flag)
        {
            Key_cnt++;
            if(Key_cnt >= 1000)		//连续1000ms有效按键检测
            {
                Key_Flag = 1;		//设置按键状态，防止重复触发

//                USBCON = 0x00;      //清除USB设置（程序进行过USB配置的话需要先清除）
//                USBCLK = 0x00;
//                IRC48MCR = 0x00;
                
                delay_ms(10);
                IAP_CONTR = 0x60;   //触发软件复位，从ISP开始执行（软件复位会重新置位RSTFLAG，进入ISP后不需要判断P3.2电平）
                while (1);
            }
        }
    }
    else
    {
        Key_cnt = 0;
        Key_Flag = 0;
    }
}

//========================================================================
// 函数: void timer0_int(void)
// 描述: Timer0 1ms中断函数。
// 参数: none.
// 返回: none.
// 版本: VER1.0
// 日期: 2022-6-11
// 备注: 
//========================================================================
void timer0_int(void) interrupt 1  //1ms 中断函数
{
    KeyResetScan();   //P3.2口按键触发软件复位，进入USB下载模式，不需要此功能可删除本行代码
}
